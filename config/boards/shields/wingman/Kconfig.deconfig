## config/boards/shields/wingman/Kconfig.deconfig
```kconfig
if SHIELD_WINGMAN_LEFT

config ZMK_KEYBOARD_NAME
    default "Wingman"

config ZMK_SPLIT_ROLE_CENTRAL
    default y

endif

if SHIELD_WINGMAN_LEFT || SHIELD_WINGMAN_RIGHT

config ZMK_SPLIT
    default y

endif

if ZMK_BACKLIGHT

config PWM
    default y

config LED_PWM
    default y

endif # ZMK_BACKLIGHT
```

## config/boards/shields/wingman/Kconfig.shield
```kconfig
config SHIELD_WINGMAN_LEFT
    def_bool $(shields_list_contains,wingman_left)

config SHIELD_WINGMAN_RIGHT
    def_bool $(shields_list_contains,wingman_right)
```
