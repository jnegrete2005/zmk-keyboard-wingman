#include "wingman.dtsi"

&kscan0 {
    col-gpios = <&pro_micro 19 GPIO_ACTIVE_HIGH>,
                <&pro_micro 8  GPIO_ACTIVE_HIGH>,
                <&pro_micro 14 GPIO_ACTIVE_HIGH>,
                <&pro_micro 4  GPIO_ACTIVE_HIGH>,
                <&pro_micro 18 GPIO_ACTIVE_HIGH>,
                <&pro_micro 3  GPIO_ACTIVE_HIGH>,
                <&pro_micro 2  GPIO_ACTIVE_HIGH>,
                <&pro_micro 1  GPIO_ACTIVE_HIGH>;
};